## fs/sefs/Kconfig
```kconfig
config SEF_FS
	tristate "eCrypt filesystem layer support"
	depends on KEYS && CRYPTO && (ENCRYPTED_KEYS || ENCRYPTED_KEYS=n)
	select CRYPTO_ECB
	select CRYPTO_CBC
	select CRYPTO_MD5
	help
	  Encrypted filesystem that operates on the VFS layer.  See
	  <file:Documentation/filesystems/sefs.txt> to learn more about
	  eCryptfs.  Userspace components are required and can be
	  obtained from <http://sefs.sf.net>.

	  To compile this file system support as a module, choose M here: the
	  module will be called sefs.

config SEF_FS_MESSAGING
	bool "Enable notifications for userspace key wrap/unwrap"
	depends on SEF_FS
	help
	  Enables the /dev/sefs entry for use by sefsd. This allows
	  for userspace to wrap/unwrap file encryption keys by other
	  backends, like OpenSSL.
```
